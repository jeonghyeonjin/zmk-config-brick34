#include "brick34.dtsi"

&kscan0 {
	col-gpios
		= <&gpio1 15 GPIO_ACTIVE_HIGH>   //Col0
		, <&gpio1 14 GPIO_ACTIVE_HIGH>   //Col1
		, <&gpio1 13 GPIO_ACTIVE_HIGH>   //Col2
		, <&gpio1 12 GPIO_ACTIVE_HIGH>   //Col3
		, <&gpio1 11 GPIO_ACTIVE_HIGH>   //Col4
		;
};

