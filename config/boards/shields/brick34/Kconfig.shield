## config/boards/shields/brick34/Kconfig.shield
```kconfig
# Copyright (c) 2020 Pete Johanson
# SPDX-License-Identifier: MIT

config SHIELD_CHOCOFI_LEFT
	def_bool $(shields_list_contains,brick34_left)

config SHIELD_CHOCOFI_RIGHT
	def_bool $(shields_list_contains,brick34_right)
```

## config/west.yml
```yaml
manifest:
  remotes:
    - name: zmkfirmware
      url-base: https://github.com/zmkfirmware
    - name: urob
      url-base: https://github.com/urob
    - name: niceviewflip
      url-base: https://github.com/invrtd
  projects:
    - name: zmk
      remote: niceviewflip
      revision: nive!view-180
      import: app/west.yml
  self:
    path: config
```
